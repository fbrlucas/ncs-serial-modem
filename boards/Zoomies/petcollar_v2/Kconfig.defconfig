## boards/Zoomies/petcollar_v2/Kconfig.defconfig
```kconfig
if BOARD_PETCOLLAR_V2_NRF9151 || BOARD_PETCOLLAR_V2_NRF9151_NS

config BOARD_PETCOLLAR_V2
	select USE_DT_CODE_PARTITION if BOARD_PETCOLLAR_V2_NRF9151_NS

endif # BOARD_PETCOLLAR_V2_NRF9151 || BOARD_PETCOLLAR_V2_NRF9151_NS
```

## boards/Zoomies/petcollar_v2/board.yml
```yaml
board:
  name: petcollar_v2
  vendor: Zoomies
  socs:
  - name: nrf9151
    variants:
    - name: ns
```
